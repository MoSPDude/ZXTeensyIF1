; ZXTeensyIF1 ROM Selector menu
; derived from TomDDG ZX Spectrum ROM Selector v1.1a
; ------------------------------------------+----------------------------------
; max 126 roms 7 bits
; x1111110
; ------------------------------------------+----------------------------------
; set _maxroms+1
MAX_PAGES   EQU 2
MAX_ROMS    EQU (29 - 1)
; set _right+1 with maximum pages
; ------------------------------------------+----------------------------------
    DEVICE ZXSPECTRUM48
MEM_SCR     EQU 0x4000  ; screen pixels
MEM_ROMTXT  EQU 0x6000  ; text
MEM_SP      EQU 0x7FF8  ; stack pointer start
MEM_KEYR    EQU 0x7FF9  ; key repeat
MEM_KEYL    EQU 0x7FFA  ; last key
MEM_TXT     EQU 0x7FFB  ; text start
MEM_POS     EQU 0x7FFD  ; cursor row
MEM_ROM     EQU 0x7FFE  ; selected ROM
MEM_PAGE    EQU 0x7FFF  ; which page
; ------------------------------------------+----------------------------------
;MEM_ORG     EQU     0x8000  ; start of code **this is for testing**
MEM_ORG     EQU      0x0000  ; start of code
MEM_NMI     EQU     MEM_ORG + 0x0038
MEM_LTBL    EQU     MEM_ORG + 0x1000 ; lookup table MEM_LTBLP-512
MEM_LTBLP   EQU     MEM_LTBL + 0x200 ; lookup table start
MEM_OFFSET  EQU     MEM_LTBL - 9;
; ------------------------------------------+----------------------------------
; initial set-up
; ------------------------------------------+----------------------------------
    org MEM_ORG
    di                                        ; disable interrupts
    ; fill lower 16K RAM with zeros
    ld hl,0x4000
    ld de,0x4001
    ld bc,0x4000
    ld (hl), 0x00
    ldir
    ;
    ld a,0x80                                ; set i to 0x80
    ld i,a
    ld sp,MEM_SP                            ; stack pointer
_memrom:
    ld a,0                                    ; set start rom (0-x)
    ld (MEM_ROM),a
_mempos:
    ld a,0                                    ; set start pos (0-20)
    ld (MEM_POS),a
_mempage:
    ld a,1                                    ; set start page (1-x)
    ld (MEM_PAGE),a
    xor a
    ld (MEM_KEYL),a                            ; reset last key
    ld de,_textData
    call _txtMem                            ; set start txt mem for page
    ld a,%00000111                            ; white border
    out (0xfe),a
    im 1                                    ; interrupt mode 1
    ei                                        ; enable interrupts
    jr _menu
; ------------------------------------------+----------------------------------
; IM1 maskable interrupt routine @ 0x0038
; ------------------------------------------+----------------------------------
    org MEM_NMI
    ei
    ret
; ------------------------------------------+----------------------------------
; Menu Routine
; ------------------------------------------+----------------------------------
_menu:
    ld hl,_compressedBlank                    ; blank explorer screen
    call _decompressScr                     ; decompress screen
    ld de,MEM_SCR+1                         ; start of ZX Spectrum ROM Explorer vx.x text on screen
    exx                                     ; alt
    ld de,_menuHeader
    call _pltText                            ; plot the text
    exx                                     ; norm
; ------------------------------------------+----------------------------------
; Plot Slider at RHS of Screen
;   max 255 ROMs can be added which is 13 pages with 21 entries per page
; ------------------------------------------+----------------------------------
    ld de,_sliderData - 13  ; get correct plot
    ld a,(_right+1)         ; get max pages
    ld b,a
    add a,a                                    ; x2
    ld c,a                                    ; x2 into c
    add a,a                                 ; x4
    add a,c                                 ; x6
    add a,a                                 ; x12
    add a,b                                 ; x13
    add a,e
    ld e,a
    adc a,d
    sub e
    ld d,a                                    ; de now correct slider plot
    ld hl,MEM_SCR+64+31                        ; start screen pixel pos
    ex af,af'                                ; alta
    ld a,(MEM_PAGE)                            ; get current page
    ex af,af'                                ; norma
_pltSliderLoop:
    ld a,(de)                                ;  get number of lines to plot
    or a
    jp z,_menuTxt                            ; if zero all done
    inc de
    ld b,a
    ex af,af'                                ; alta
    ld c,%01111110                            ; set to clear slider
    dec a
    jr nz,_noSlider                            ; if not the current page skip reassignment
    ld c,%01000010                            ; set to plot slider
_noSlider:
    ex af,af'                                ; norma
_sliderLoop:
    ld (hl),c                                ; plot slider or clear to screen
    inc h                                    ; down one within char row
    ld a,h
    and %00000111                            ; check if char complete (8 rows)
    jr nz,_sliderChar
    ld a,l
    add a,32                                ; if complete move down one
    ld l,a
    jr c,_sliderChar                        ; into next screen sector?
    ld a,h
    sub 8                                    ; now so back up to top of char
    ld h,a
_sliderChar:
    djnz _sliderLoop
    jr _pltSliderLoop
; ------------------------------------------+----------------------------------
; pre-defined table to plot the slider
; ------------------------------------------+----------------------------------
_sliderData:
    defb 160,  0,  0,  0,  0,  0, 0, 0, 0, 0, 0, 0, 0            ; 1 page
    defb  80, 80,  0,  0,  0,  0, 0, 0, 0, 0, 0, 0, 0            ; 2 pages
    defb  53, 54, 53,  0,  0,  0, 0, 0, 0, 0, 0, 0, 0            ; 3 pages
    defb  40, 40, 40, 40,  0,  0, 0, 0, 0, 0, 0, 0, 0            ; 4 pages
    defb  32, 32, 32, 32, 32,  0, 0, 0, 0, 0, 0, 0, 0            ; 5 pages
    defb  27, 27, 26, 26, 27, 27, 0, 0, 0, 0, 0, 0, 0            ; 6 pages
    defb  22, 23, 23, 23, 23, 23, 23, 0, 0, 0, 0, 0, 0
    defb  20, 20, 20, 20, 20, 20, 20, 20, 0, 0, 0, 0, 0
    defb  17, 18, 18, 18, 18, 18, 18, 18, 17, 0, 0, 0, 0
    defb  16, 16, 16, 16, 16, 16, 16, 16, 16, 16, 0, 0, 0
    defb  14, 14, 14, 15, 15, 15, 15, 15, 15, 14, 14, 0, 0
    defb  13, 13, 13, 13, 14, 14, 14, 14, 13, 13, 13, 13, 0
    defb  12, 12, 12, 12, 13, 13, 13, 13, 12, 12, 12, 12, 12
; ------------------------------------------+----------------------------------
; Show all the text (variable width)
; ------------------------------------------+----------------------------------
_menuTxt:
    ld de,MEM_SCR+64                         ; start of text on screen
    exx                                     ; alt
    ld de,(MEM_TXT)                            ; get text start
    call _pltText                            ; plot the text
    exx                                     ; norm
; ------------------------------------------+----------------------------------
; Colour in selection bar to mimic 128k menu
; ------------------------------------------+----------------------------------
_menu100:
    ld a,(MEM_POS)                            ; get pos from storage
    ld c,a                                    ; pos into c
_menu200:
    call _colbar                            ; colour in the bar
; ------------------------------------------+----------------------------------
; Simple key up/down routine, with key repeat
;   0.7 second wait for 1st repeat, then 0.1 seconds
; ------------------------------------------+----------------------------------
_menu300:
    call _getkey                            ; get key press
    and %00111111
    jr z,_menu370                            ; key up
    ld b,a
    ld a,(MEM_KEYL)                            ; get last key
    cp b
    jr nz,_menu350
    halt                                    ;  wait 1/50th second
    ld a,(MEM_KEYR)
    dec a
    jr nz,_menu360
    ld a,5                                    ; 0.1seconds
    ld (MEM_KEYR),a                            ; clear key repeat delay
    ld a,b
    jr _menu450
_menu350:
    ld a,b
    ld (MEM_KEYL),a                            ; store new key
    ld a,35                                    ; 0.7seconds
_menu360:
    ld (MEM_KEYR),a                            ; clear key repeat delay
    jr _menu300
_menu370:
    ld a,35                                    ; 0.7seconds
    ld (MEM_KEYR),a                            ; clear key repeat delay
_menu400:
    call _getkey                            ; get key press
    and %00111111                            ; wait for key down
    jr z,_menu400
_menu450:
; ------------------------------------------+----------------------------------
; Simple beeper routine to simulate basic keyclick
;   port 0xfe -> 0,0,0,ear,mic,border,border,border
; ------------------------------------------+----------------------------------
    ld e,a                                    ; preserve a
    ld b,0x3f
    ld a,%00011111                            ; keep border white and mic/ear bits set
    out (0xfe),a
_clickLoop:
    djnz _clickLoop                            ; wait 63*13t -5t = 814t
    ld a,%00001111                            ; switch ear bit to zero to create tiny click
    out (0xfe),a
    ld a,e                                    ; restore a
; ------------------------------------------+----------------------------------
; Check which button pressed using carry flag
;   bit 0 - fire, bit 1 - left, bit 2 - right, bit 3 - up, bit 4 - down
; ------------------------------------------+----------------------------------
    rra                                        ; fire pressed
    jp c,_romSelected
    rra                                     ; left pressed
    jp c,_left
    rra                                        ; right pressed
    jr c,_right
    rra                                        ; up pressed
    jr c,_up
; ------------------------------------------+----------------------------------
; Down pressed - down one row or to next page if at bottom
; ------------------------------------------+----------------------------------
    ld a,c
    cp 20                                    ; at bottom? (0-20 or 21 entries)
    jr nz,_down100                            ; if at bottom jump to pgdn
    ld a,(_right+1)                            ; max pages
    ld b,a
    ld a,(MEM_PAGE)                            ; current page
    cp b
    jr z,_menu300                            ; if at max do nothing
    inc a
    ld (MEM_PAGE),a                            ; page down
    xor a
    ld (MEM_POS),a                            ; back to the top
    ld a,(MEM_ROM)
    inc a                                    ; back to the top
    jr _right200
_down100:
    ld a,(MEM_ROM)
_maxroms:
    cp MAX_ROMS     ; pre-loaded max roms (-1 as 0 to max)
    jr z,_menu300   ; at maximum? if so do nothing
    inc a
    ld (MEM_ROM),a
    call _clrbar                            ; clear coloured line
    inc c                                    ; pos +1
    jr _up100
; ------------------------------------------+----------------------------------
; Up pressed - up one row or previous page if at top
; ------------------------------------------+----------------------------------
_up:
    ld a,c
    or a                                    ; at top?
    jr nz,_up050                            ; if at top jump to pgup
    ld a,(MEM_PAGE)
    dec a
    jp z,_menu300                            ; if already at 1st then do nothing
    ld (MEM_PAGE),a                            ; page down
    ld a,20
    ld (MEM_POS),a                            ; to bottom
    ld a,(MEM_ROM)
    dec a                                    ; back one rom
    jr _right200
_up050:
    ld a,(MEM_ROM)
    or a
    jp z,_menu300                            ; if rom=0 do nothing
    dec a
    ld (MEM_ROM),a
    call _clrbar                            ; clear coloured line
    dec c                                    ; pos -1
_up100:
    ld a,c
    ld (MEM_POS),a
    jp _menu200
; ------------------------------------------+----------------------------------
; Right pressed - Page Down
;   _right+1 is max pages
; ------------------------------------------+----------------------------------
_right:
    ld b, MAX_PAGES ; pre-loaded max pages
    ld a,(MEM_PAGE) ; current page
    cp b
    jr nz,_right100                         ; if not zero then page down
    call _clrbar                            ; clear coloured line
    ld a,(MEM_ROM)
    ld b,a
    ld a,(_maxroms+1)
    ld (MEM_ROM),a                            ; rom = maxrom
    sub b
    add a,c
    ld (MEM_POS),a
    jp _menu100
_right100:
    inc a
    ld (MEM_PAGE),a                            ; page down
    ld a,(MEM_ROM)
    add a,21                                ; add 21 roms
    ld b,a                                    ; now need to check not > maxroms
    ld a,(_maxroms+1)
    cp b
    jr nc,_right150                            ; if rom > maxroms then fix
    ld e,a                                    ; e=maxrom
    sub b                                    ; difference max to over
    add a,c
    ld (MEM_POS),a
    ld b,e                                    ; b=maxrom
_right150:
    ld a,b
_right200:
    ld (MEM_ROM),a
    call _txtMem                            ; get start of new page text
    jp _menu
; ------------------------------------------+----------------------------------
; Left pressed - Page Up
; ------------------------------------------+----------------------------------
_left:
    ld a,(MEM_PAGE)                            ; which page
    dec a
    jr nz,_left100                            ; if not zero then page up
    ld (MEM_ROM),a                            ; just move to top
    ld (MEM_POS),a                            ; which is row & rom=0
    call _clrbar                            ; clear coloured line
    jp _menu100
_left100:
    ld (MEM_PAGE),a
    ld a,(MEM_ROM)
    sub 21                                    ; one page up but same position
    jr _right200
; ------------------------------------------+----------------------------------
; Write the menu index to the Teensy at port 0xeb, then redraw any changes
; ------------------------------------------+----------------------------------
_romSelected:
    ld a,(MEM_ROM)
    out (0xeb),a
    nop
    nop
    nop
    jp _menu
; ------------------------------------------+----------------------------------
; Find correct MEM_ROMTXT start depending on page and load into MEM_TXT
; ------------------------------------------+----------------------------------
_txtMem:
    ld de,_textData
    ld a,(MEM_PAGE)
    ld c,a
_txtMem100:
    dec c                                    ; correct page?
    jr z,_txtMem300                            ; page correct
_txtMem200:
    ld a,(de)                                ; get char
    inc de
    or a                                    ; search for end marker
    jr nz,_txtMem200
    jr _txtMem100                            ; see if this page is right
_txtMem300:
    ld (MEM_TXT),de                            ; store for other routines
    ret
; ------------------------------------------+----------------------------------
; Get KeyPress
;   reads 6,7,8,9,0,5,4,3,2,1,h,j,k,l & enter to get byte 000durlf
;   l=left(5), r=right(8), d=down(6), u=up(7), f=fire(enter)
;   0xef (6,7,8,9,0) 0xdf (y,u,i,o,p) 0xbf (h,j,k,l,en) 0x7f (b,n,m,ss,sp)
;   0xf7 (5,4,3,2,1) 0xfb (t,r,e,w,q) 0xfd (g,f,d,s,a) 0xfe (v,c,x,z,sh)
; ------------------------------------------+----------------------------------
_getkey:
    ld a,0xef                                ; read 6,7,8,9,0 (6 down, 7 up, 8 right)
    in a,(0xfe)                                ; read
    cpl                                        ; so keypress = 1 not 0
    and %00011100                            ; only keep 6,7,8
    ld b,a
    ld a,0xbf                                ; read h,j,k,l,enter
    in a,(0xfe)                                ; read
    cpl                                        ; so keypress = 1 not 0
    and %00000001                            ; only keep enter
    or b
    ld b,a
    ld a,0xf7                                ; read 5,4,3,2,1
    in a,(0xfe)                                ; read
    rrca
    rrca
    rrca                                     ; move 5 to bit 1
    cpl                                        ; so keypress = 1 not 0
    and %00000010                            ; only keep 5
    or b                                    ; bring in the rest
    ret
; ------------------------------------------+----------------------------------
; Colour in the Select Text
;   either colour in cyan (_colbar) or clear with white (_clrbar)
; input: c=char row (preserved)
; ------------------------------------------+----------------------------------
_clrbar:
    ld d,%01111000                            ; paper=white
    jr _colbar100
_colbar:
    ld d,%01101000                            ; paper=cyan
_colbar100:
    ld a,c
    add a,2                                 ; 2-23
    add a,a                                    ; x2
    add a,a                                    ; x4
    add a,a                                    ; x8 (max 23*8=184)
    ld l,a
    ld h,0
    add hl,hl                                 ; x16
    add hl,hl                                 ; x32
    ld a,h
    add a,0x58                                ; ATTR
    ld h,a
    ld b,31                                    ; colour in 31 chars
_colbarLoop:
    ld (hl),d
    inc l
    djnz _colbarLoop
    ret
; ------------------------------------------+----------------------------------
; Variable Width Text Plot Routine
;   plots ASCII char from 32 (space) to 127 (copyright)
;     plus 4 icons at position 28,29,30 & 31
;   three escape codes also checked
;      0 (NUL) exits routine
;      9 (TAB) which moves the cursor to rhs of screen, used to plot if1 icon
;     10 (LF) which moves the cursor down one char row
;   anything entered different to above just exits, so >127 & <28
; input: de - memory location of text to plot
; ------------------------------------------+----------------------------------
_pltText:
    ld bc,0x0000                            ; gap & rotation =0
_pltTextLoop:
    ld a,(de)                                ; get char
    ld hl,_gapLengthData-32
    add a,l
    ld l,a
    adc a,h
    sub l
    ld h,a                                     ; hl now correct width of char
    ld b,(hl)                                 ; b=gap, c=rotation
    ld a,c
    add a,a                                 ; x2
    add a,MEM_LTBL/256
    ld h,a                                    ; h now correct high byte in lookup table for the rotation
    ld a,(de)                                ; get char again
    inc de                                    ; next mem
    add a,a                                 ; x2 (max char=127)
    ret z                                    ; return on char=zero
    ret c                                    ; return on char > 127
    cp 18                                    ; check for tab (9*2)
    jr nz,_noTab
    exx                                        ; norm
    ld a,e
    and %11100000                             ; back to left hand side of screen
    or %00011101                            ; move to right hand side of screen
    ld e,a
    jr _lf100
_noTab:
    cp 20                                     ; check for line feed (10*2)
    jr nz,_noLf
    exx                                     ; norm
    ld a,e
    and %11100000                             ; back to left hand side of screen
    add a,32                                ; move one line down
    ld e,a
    jr nc,_lf100                            ; if no carry then no need to adjust screen high byte
    ld a,d
    add a,8                                    ; move down one screen sector
    ld d,a
_lf100:
    exx                                     ; alt
    ld c,0                                     ; reset rotation
    jr _pltTextLoop
_noLf:
    cp 52                                    ; check for invalid char <28
    ret c
    exx                                     ; norm
    ld l,a
    ld h,0
    add hl,hl                                 ; x4
    add hl,hl                                 ; x8
    ld bc,_shiftedFontData-256                 ; -256 as space is 32 which *8 is 256
    add hl,bc                                ; hl now correct graphic location
    exx                                     ; alt
    ld a,c                                    ; rotation
    exx                                     ; norm
    ld c,d
    ld b,8
    ex de,hl
    or a                                     ; check if any rotation
    jr nz,_rotatedVersion
_nonRotatedLoop:
    ld a,(de)                                ; get byte
    ld (hl),a                                ; to screen
    inc de                                    ; next byte
    inc h                                    ; down one char row
    djnz _nonRotatedLoop
    jr _rotationDone
_rotatedVersion:
    ld a,(de)
    inc de
    exx                                     ; alt
    ld l,a                                    ; byte into rotation lookup table low byte
    ld a,(hl)                                ; get lhs
    exx                                     ; norm
    or (hl)                                    ; or with screen, not overwritten
    ld (hl),a                                ; put or'd byte to screen
    exx                                     ; alt
    inc h                                    ; to rhs of rotation lookup table
    ld a,(hl)                                 ; get rhs
    dec h                                    ; back to lhs of rotation lookup table
    exx                                        ; norm
    inc hl
    ld (hl),a
    dec hl
    inc h
    djnz _rotatedVersion
_rotationDone:
    ex de,hl
    ld d,c
    exx                                     ; alt
    ld a,b
    add a,c                                 ; add char width to current rotation to get new rotation
    cp 8                                    ; if >7 then move the next char
    jr c,_newRotation
    exx                                     ; norm
    inc de                                    ; next char
    exx                                     ; alt
    sub 8                                    ; if in next char reduce rotation by 8 bits
_newRotation:
    ld c,a                                    ; put new rotation into c
    jr _pltTextLoop
_menuHeader:
    defb "ZXTeensyIF1 "
_verText:
    defb "20260202", 0
; ------------------------------------------+----------------------------------
; Left Aligned Sinclair ZX Spectrum Font - used for variable width font routine
;   first 6 are icons, then space (32) to copyright (127) (128+4 *8=1056b)
; ------------------------------------------+----------------------------------
    DEFB    128,128,128,128,128,128,128,128 ; 26 - left hand side
    DEFB    128,130,132,132,136,168,144,128 ; 27 - checkmark
    DEFB    127,197,245,238,221,197,127,  0 ; 28 - zxc_l
    DEFB    252,102, 94,222, 94,102,252,  0 ; 29 - zxc_r
    DEFB     31, 16, 23, 16, 16, 31,  7,  0 ; 30 - if2_l
    DEFB    248,  8,136,  8,  8,248,224,  0 ; 31 - if2_r
_shiftedFontData:
    DEFB      0,  0,  0,  0,  0,  0,  0,  0    ; 32 - space
    DEFB      0, 64, 64, 64, 64,  0, 64,  0
    DEFB      0, 72, 72,  0,  0,  0,  0,  0
    DEFB      0, 36,126, 36, 36,126, 36,  0
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    DEFB      0, 40, 80,  0,  0,  0,  0,  0
    DEFB     28, 34, 93, 81, 93, 34, 28,  0    ; 127 - copyright
; ------------------------------------------+----------------------------------
; Length of each Char - used for variable width font routine (100b)
; ------------------------------------------+----------------------------------
    defb 8,8,8,8,8,8                        ; 6 icons
_gapLengthData:                                ; start at space (32)
    defb 4,2,5,7,6,7,7,3,3,3,6,6,3,6,3,6,7,6,7,7,7,7,7,7,7,7,2,3,4,6,4,7
;          ! " # $ % & ' ( ) * + , - . / 0 1 2 3 4 5 6 7 8 9 : ; < = > ?
    defb 7,7,7,7,7,7,7,7,7,6,7,7,7,7,7,7,7,7,7,7,8,7,7,7,7,8,7,4,6,4,6,8
;        @ A B C D E F G H I J K L M N O P Q R S T U V W X Y Z [ \ ] ^ _
    defb 7,6,6,5,6,6,4,6,6,4,5,5,4,6,6,6,6,7,5,6,5,6,6,6,6,6,6,6,2,6,5,8
;         £ a b c d e f g h i j k l m n o p q r s t u v w x y z { | } ~ copyright
; ------------------------------------------+----------------------------------
; Compressed Screen Decompression Routine (33b)
;   very simple and fast lz with 256byte backward look
; input: hl - memory location of compressed screen or text block
; ------------------------------------------+----------------------------------
_decompressScr:
    ld de,MEM_SCR                            ; start of screen pixels
_decompressTxt:
    ld b,e                                    ; b=0
    jr _loop
_copy:
    inc a
    ld c,a                                    ; loop counter into bc for ldir
    ldir
_loop:
    ld a,(hl)                                ; get byte
    inc hl
    cp 128                                    ; end?
    ret z
    jr c,_copy                                ; if <128 straight copy a times
    sub 126                                    ; offset copy length max 130
    ld c,(hl)                                ; get offset b=0, c 0=1, 255=256
    inc hl
    push hl                                    ; preserve compression pos
    ld h,d
    ld l,e
    sbc hl,bc                                ; shift screen pos by offset bc
    dec hl                                    ; -1 as 1to256 not 0to255
    ld c,a                                    ; loop counter into bc for ldir
    ldir
    pop hl
    jr _loop                                ; restore compression pos
; ------------------------------------------+----------------------------------
; Compressed ROM Selector Blank Screen
; 383bytes (from 6912b, 94% compression)
; ------------------------------------------+----------------------------------
_compressedBlank:
  defb 0x00,0x00,0x97,0x00,0x00,0x01,0x82,0x00,0x01,0x00,0x80,0x98,0x20,0x83,0x3a,0x9d
  defb 0x1f,0x00,0x7e,0xff,0x1f,0x9d,0x9f,0x98,0xff,0x00,0x03,0x82,0x00,0x01,0x00,0xb0
  defb 0xff,0xff,0xf6,0xff,0x00,0x07,0x82,0x00,0x01,0x00,0xae,0x9c,0xff,0x00,0x18,0xff
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  defb 0xff,0xff,0xff,0xff,0xff,0x9a,0xff,0x9a,0x00,0x03,0x06,0x01,0x03,0x03,0x80
_codeend:
    org MEM_OFFSET
    jp (_verText)
    jp (_maxroms + 1)
    jp (_right + 1)
;
; ------------------------------------------+----------------------------------
; Byte Rotation Lookup Table
;   used for variable width font routine
; 3584b
; ------------------------------------------+----------------------------------
    org MEM_LTBLP
    defb 0x00,0x00,0x01,0x01,0x02,0x02,0x03,0x03,0x04,0x04,0x05,0x05,0x06,0x06,0x07,0x07
    defb 0x08,0x08,0x09,0x09,0x0a,0x0a,0x0b,0x0b,0x0c,0x0c,0x0d,0x0d,0x0e,0x0e,0x0f,0x0f
    defb 0x10,0x10,0x11,0x11,0x12,0x12,0x13,0x13,0x14,0x14,0x15,0x15,0x16,0x16,0x17,0x17
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    defb 0xe0,0xe2,0xe4,0xe6,0xe8,0xea,0xec,0xee,0xf0,0xf2,0xf4,0xf6,0xf8,0xfa,0xfc,0xfe
; ------------------------------------------+----------------------------------
; ROM text entry data at 0x2000
; ------------------------------------------+----------------------------------
_textData:
    defb 30,"Turn ZX PicoZXCx Unit Off",10
    defb 26,"ROM Tester",9,28,29,10
    defb 27,"Looking Glass ROM",10
    defb 26,"Retroleum DiagROM v1.59",10
    defb 27,"ZX Spectrum Diagnostics v0.37",9,28,29,10
    defb 26,"ZX Spectrum Test Cartridge",10
    defb 30,"128k RAM Tester",10
    defb 30,"Where Time Stood Still (128k)",9,26,27,10
    defb 30,"Automania",9,26,27,10
    defb 30,"Chase H.Q. (128k)",9,26,27,10

    DISPLAY "codeEnd address is:",/A,_codeend
    DISPLAY "MEM_OFFSET address is:",/A,MEM_OFFSET
    DISPLAY "MEM_LTBL address is:",/A,MEM_LTBL
    DISPLAY "textData address is:",/A,_textData
    DISPLAY "maxRoms address is:",/A,(_maxroms+1)
    DISPLAY "maxPages address is:",/A,(_right+1)
    ;savetap "MENU.TAP", MEM_ORG
    savebin "MENU.ROM", MEM_ORG, $2000
